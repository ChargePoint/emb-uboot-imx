/*
 * This is a Device Tree representation of the public keys that will
 * be used for FIT image verification.
 *
 * These are manually generated using a mkimage process that is basically
 * - Create a empty pubkey.dts file
 *   /dts-v1/;
 *   / {
 *   };
 *
 * - Compile the dts
 *   $ dtc -O dtb pubkey.dts > pubkey.dtb
 * - Sign a FIT image and output the Keys used to sign (ensure its uses keys)
 *   $ mkimage -f some.its -k keys -r -K pubkey.dtb temp-fitname.itb
 * - Generate the device tree source
 *   $ dtc -I dtb pubkey.dtb > pubkey.dts
 *
 * At this point, copy the signature from the pubkey.dts into this file and
 * update the `required` property with a preceeding "dev:" or "prod:" key that the
 * board code will change based upon the SoC being open or closed during
 * the secureboot provisioning process and fuse burns.
 */
/ {
	signature {
		key-fit-dev-ec {
			ecdsa,y-point = <0xfd0db3e7 0x86bd621a 0xcab4c169 0x3caff19f 0xb836f881 0xaa9867d9 0x5c83aa7e 0x33cf66f2>;
			ecdsa,x-point = <0x4a5c54e7 0x5d5cb2ff 0x5451ace6 0xc555e265 0xa0e68f94 0x152518e8 0x7966955b 0x82b9ae64>;
			ecdsa,curve = "prime256v1";
			required = "dev:conf";
			algo = "sha256,ecdsa256";
			key-name-hint = "fit-dev-ec";
		};

/*		key-fit-dev {
			required = "dev:conf";
			algo = "sha256,rsa4096";
			rsa,r-squared = <0x89beb82c 0x4acc3af6 0xe6100471 0x4c2d2cc3 0xe55b841 0xc20d6c88 0x9f618128 0xdd56c1c0 0x67112ce9 0x7a8aa8d6 0x738d93c4 0x2257b27b 0x5ec7980f 0x85a2ba21 0x37d22692 0x8a67a1c0 0xb5013fdc 0x9bbac62a 0xfe286d83 0xd8145957 0xf6e0258a 0x9974db6b 0x27a28c08 0xca38cee2 0x668488a1 0xa38df49 0x91427631 0xba2aea74 0x3896c61f 0x663cda7c 0xc66b5f54 0x16131777 0x6819dcbc 0x7ab865c2 0xa469e4a1 0xea4ca3a5 0x61772a4 0x827b15e0 0x543cfdc3 0x4082f89c 0xb86dd61a 0x4199379d 0x764e5da3 0x6ecf8187 0x55ca3db6 0x38f0e4ea 0xc7ed23ea 0x5a62c2a4 0x9149a1d1 0xfe2ed2b4 0xd2a82090 0x76bc6566 0x99aa2c9a 0x77287536 0xf82b15df 0xbcdfaffc 0x64ef48d9 0xbdbbfb8 0x72d28c4e 0x761f6cf8 0xf66f3464 0x2df02ef5 0xb502577f 0x8b1144ce 0x425efd64 0x9812dba8 0xe3b4249c 0x3d0f6a4d 0x484f837b 0x23f416b6 0x53356b0a 0x4112992c 0x25064953 0xbd7a1604 0x2a9cd12c 0xe4d864f2 0xb7245fdf 0xc0a7841b 0xf3262c1e 0xf0b15b6d 0xf644efb0 0x314dc405 0xa832a0f4 0x6e2bc74e 0x33b81c9d 0x760ee8e3 0x370a0811 0xd8798165 0x195f6a60 0x775b73f5 0x52b64cdd 0xbddc4498 0x85cbbf3b 0x21a6ed3d 0x81fe0756 0x5e2134fb 0x583e2a2e 0xbfc79065 0x468548a2 0xf6797529 0x612b5f2 0x3cc9bd21 0x143fb64 0x8327b0f3 0xaacb7cdd 0x2fcd572b 0x10477c 0x249807b1 0x34958d0f 0x33eabbda 0x4f4b6328 0xda53d72e 0x7a432620 0x604cfb0 0xaa051389 0x29d8da9d 0xd0bd03cd 0x562a649f 0x886f2af9 0xa1b551d0 0x4ff86748 0xb3bcc3d0 0xe995c9f0 0xc8674d63 0x97fadfc8 0x9882420b 0x6532c3cc 0x64a49339>;
			rsa,modulus = <0xfb8903a0 0xed44abf1 0xe37a1bc2 0x5f03afa0 0x86dae397 0x225eee24 0x45159c95 0xdda3a234 0x854abacd 0xdd09c8a4 0x7480313c 0x8bdd7b79 0x6ddae881 0x682bc3d7 0xedc450fe 0x905cc29 0xe3c25bf9 0x33bbd153 0xceec626c 0xd4e5d625 0xad6f6f6c 0x1b8ea04d 0xd971b457 0xf035fe01 0x8c4d0f48 0x3a2d6b66 0x2bf3a17c 0xb43de566 0xfc0d53fc 0x4cb40483 0xec0b45a7 0x539fec19 0x5d482f38 0xeffc63c6 0x74f987de 0x9e9454f7 0xe9177aa6 0x904ac0f2 0x166af7e3 0x49788773 0x807636dd 0xa373e3be 0x50484b0a 0xb60182fc 0x964e42c2 0x2bd6daf8 0xf25fb947 0xca37b75c 0x63a3b523 0x5a38d788 0xc599121f 0xb2ffeb15 0x186a64d9 0x408d05c9 0x845d6a6b 0xa0c94140 0xb40b8a6c 0x817b9a34 0xb02be30a 0x6b2e3cf9 0xb661987d 0xd2443e7b 0xd6f7f7f1 0x9df69989 0x2bbe9825 0x5d9b59af 0x89751f91 0x32b0525a 0x11c2b26d 0xfb7ad888 0x802cc4e1 0xe40d8e28 0x687a687e 0x891a60ce 0x45bbc25d 0xa6ae2013 0xbfd9cbec 0xd8489150 0x142d5633 0xa62eaea 0x96b5f961 0xb7e9ac1f 0x498a0a83 0x80bd3181 0x60471f76 0xfd8fa629 0xc964f172 0xf3b5ad0e 0x876a2239 0x254166dc 0xa8fa09bb 0x94b093fd 0xe481fe92 0x2b0ce59d 0xd98236bf 0xe1268d5e 0xe9c6917a 0xfd8d4d5b 0x65d1e27a 0x5aafa8f4 0xdf70d1e8 0xecce9a1d 0x33d5f048 0x9a827b67 0x2f429bac 0x90ca51a4 0x56dbe158 0x6e32a39e 0xeef8e62c 0x1740fede 0xac767948 0x1da742d8 0xb91aac74 0xdfbb15c 0x6cbbcd80 0x8acd9390 0x4a97e578 0xb0e4ed8c 0x43b9230b 0x5650b340 0xc26871ff 0xa3f1d901 0x862a7155 0x53cb7ba0 0xcd39c5d1 0x5b45116a 0x5a990358 0xb36ea045>;
			rsa,exponent = <0x00 0x10001>;
			rsa,n0-inverse = <0x1f688d73>;
			rsa,num-bits = <0x1000>;
			key-name-hint = "fit-dev";
		};
		*/
	};
};
