/*
 * This is a Device Tree representation of the public keys that will
 * be used for FIT image verification.
 *
 * The procedure to generate this file from production keys in AWS CloudHSM is
 * avaliable here:
 * https://github.com/ChargePoint/emb-platform/blob/master/os/buildroot/package/emb-sbsigner/README.md
 */

/ {
	signature {
		key-fit-prod-kcb {
			/* TODO: Generate Production Key.
			 *     This is a throwaway key for verification of the secure boot
			 *     logic prior to generating production keys.
			 */
			required = "prod:conf";
			algo = "sha256,rsa4096";
			rsa,r-squared = < 0x30929c0c 0xf6e062e3 0xa7c2edb9 0x6fa1dc4b 0x49ae685 0xe051ae04 0x50aed006 0x268108f7 0x1ffa97b8 0xf8db8ab5 0xb5d45502 0xaa4e613f 0x43e212a2 0x2a3052c6 0xd5f545f6 0x46efec2d 0xc6329441 0x7a77ff31 0xd3b4f9c6 0x7b6aa617 0x48c3d492 0x43528087 0xebc19748 0xa37d02b8 0xef91690a 0x4c968785 0x5b6e2e52 0x15e8c6ff 0x9a8d6f80 0x8357e839 0xabe8982c 0x88be117d 0x9cdbf85 0x5a2a379a 0x8d4993a7 0xac54cbb8 0x1ad43ad2 0xbad10a5f 0xbf7b60b7 0xabe2eac 0x6e3f42af 0x2809c5f1 0x1d6946a2 0x37f65b61 0x81f880eb 0x8f1ebe67 0x92123995 0x264cc9a6 0x56f0a8f5 0xc010bf60 0x570a35cc 0xd2c73528 0xbf9f2448 0xbc0e49ca 0x6111f148 0x915dad27 0xcb375de6 0xae440a7 0x96457af8 0xc72c6fc0 0xc1123fa1 0x7d421981 0xec2a237c 0xfff18d14 0xa065b677 0xb03df8f8 0xc8d1032c 0xbd9bb6c4 0x472893e8 0x68221a61 0xf4ae687 0xfcc913a3 0x6bda064a 0x8939b489 0xccb4907f 0x9ce0516 0x2c718957 0x7d8abc2 0xdf17536a 0xe18f3544 0x976d5f8c 0x14cb9a0e 0xc04ca54a 0xafab5997 0xe7eb5378 0x698f2869 0x56a59790 0x28a9659f 0xe2ac9d4a 0x65f266dc 0xff17f7e4 0x68c2169 0xfcc09e36 0x476fb9b8 0x3c10c72f 0xef3b8746 0xe6f08a2f 0x1e8e9c73 0x61983837 0x673c166f 0x12f2cb42 0xf66f0bcb 0x4de00df9 0xc938509c 0x5d19a010 0x76f1b7d1 0xc011bfe5 0xc82e7104 0xd28791f5 0x584c587b 0x7e6c7f08 0x3453a564 0xc2004588 0xcd84c75e 0x8cdfc38b 0x81e80a7 0x97619a9f 0x165fa171 0x77483392 0x25ba1c93 0xe01d3ad7 0xb65322b6 0x296a2882 0x99784f02 0xb0f85f83 0x93c8be96 0x24de00cf 0x9f803a74 >;
			rsa,modulus = < 0xd389e760 0x4a8fefe8 0xe7ff2e6 0xef620044 0x788011d6 0xb83a74cd 0x4463c7a7 0x8b924d71 0x581996be 0x6086b03d 0xdce3972c 0x9ecc87ee 0x5b54e3c3 0x38b4f1c5 0x828aa388 0x1f04df33 0x1f4c9fbb 0x508a2156 0x2ef5f1cb 0x3f41f020 0x30807c0b 0xfebc35a4 0xb8608570 0xbe92b7eb 0xe82626e4 0x7951afcb 0xeefa05bc 0x571e00b6 0xecd6b7b8 0x4eceba5d 0x64f26465 0xa2856ddb 0x35add491 0x5ccf3735 0x3da57e3b 0x7c57fe15 0x9cd58b46 0x3a8e2403 0x5196777f 0xbf8306a7 0x6ae1aafa 0xa67d9396 0xbbd1fc5 0xb7dc3dd3 0x9d23fbf7 0x3002e801 0xf533ba51 0x6e6764f6 0x9f4fd5a5 0x459fbec7 0xfb7522d2 0x5dfa83dd 0x812fbf68 0xcbbe5b1e 0xf6df1e01 0x84c8d482 0x812e496d 0x49222197 0x7f13a90e 0x8a4c07bc 0xe2322407 0xcb1cb0c7 0xbd9a618c 0xc457a60f 0xb8371918 0x8b3df949 0x81f62ab3 0x12aadcd5 0xeaf5f371 0xc0615dbb 0xc0cdca41 0x7ccf14ab 0x3d23c6f4 0x6f22c3ca 0xd8bad72a 0x1a7c13bc 0x8dbe9bef 0x85ea19f2 0x1ee364c8 0xb5138d4f 0x347465f2 0x427569e1 0x9c4d7d3f 0xd540d191 0xc3f14a2 0x7d61e745 0x76f1908d 0xcd5acaef 0x3c61065d 0x326790fe 0x6f298e60 0x2401045a 0x647e4182 0xd156c57b 0x83cacca6 0x7587ee55 0x3872fff7 0x4bb14193 0xef23cb49 0x3c4050bf 0x8c1b77ef 0xa7b6ad88 0xc633cf93 0x2408b370 0x9f18b124 0xa52a51bd 0x30e8c748 0x192bf5ba 0x7b900e3f 0xd79be484 0x1c0175d0 0xfa0ca3b8 0x56842d63 0x49e14676 0xaa1d161b 0x3ca2e478 0xaa247c6b 0xd0ac2e32 0x24f597eb 0xa88e2558 0x3913fbc4 0x1882cf3d 0xf43eded 0x33e6c5e6 0x1a27b714 0x1aadf5c3 0x73dc0fc6 0xaf4f1e95 >;
			rsa,exponent = < 0x00 0x10001 >;
			rsa,n0-inverse = < 0x13a24343 >;
			rsa,num-bits = < 0x1000 >;
			key-name-hint = "fit-prod-kcb";
		};
	};
};

