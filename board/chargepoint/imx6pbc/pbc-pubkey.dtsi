/*
 * This is a Device Tree representation of the public keys that will
 * be used for FIT image verification.
 *
 * The procedure to generate this file from production keys in AWS CloudHSM is
 * avaliable here:
 * https://github.com/ChargePoint/emb-platform/blob/master/os/buildroot/package/emb-sbsigner/README.md
 */

/ {

	signature {

		/* TODO: key-fit-mfg-qa */

		key-fit-mfg-prod {
			required = "mfg-prod:conf";
			algo = "sha256,rsa4096";
			rsa,r-squared = < 0x65854e2a 0xbe5368d1 0x604d98bb 0xaead29ce 0xbbaf9797 0x2530e634 0xc803c11 0x4131c4ef 0xd82b02c5 0xf18169de 0xbb28d49a 0xc129032d 0xf4ef548 0xbca93a6c 0x3a64851b 0x17c00877 0x49a2702f 0x7bd35fb6 0xa823cab6 0x64d2e4af 0x25cf24d7 0xd999fa39 0x54c132c4 0x37679330 0x4055c414 0x9e5ee1f0 0x6aa1e55e 0x6f69e0d 0xe6a5c662 0x8f1bf778 0xecae8f89 0x3bdc2c6e 0x175cfd26 0xc672137d 0xcf8d0bba 0x85937aad 0x95d639fc 0xa9ec299f 0x95f8108f 0x829cfd2e 0xef56aefb 0xa8860664 0x82a18eff 0xb6a1a86d 0xaca64e7c 0x510eabce 0xb51631db 0xd5af4c0f 0x6f44d810 0x5499d72b 0xcf8ad49 0xa603acf9 0xd72a8548 0x9ca0f25f 0x18e31873 0xb081d421 0x98928dd5 0x2d206a42 0x58e9b80b 0x946593cb 0x63e41830 0x1fbdb1b9 0x91660f8f 0x281d70e6 0xcb420416 0xda8e2e9e 0xa1f2efcd 0x33e763d3 0xe53528ec 0x77a41571 0x9b87d006 0x37a375dc 0xb86a1d38 0x6b22fe44 0x625d5e54 0xf31ffc8b 0x359c7830 0x5983c686 0x599f2e02 0xc208a23c 0x3b018233 0xa615e7af 0x47f008f3 0x9b3a1733 0xafd7ed6b 0x14b67572 0xf496e3fd 0x30a18216 0xb68c7ed0 0xec09149a 0xca5e2864 0xf13be3ee 0x2083fb7 0x4887259d 0x16c332f3 0x58c66a90 0x77029210 0x981a5459 0x142398c4 0xad051c7a 0xa1a3e8a4 0x51378330 0x18513930 0x3408040b 0x572b23a9 0xab236487 0xcf6bd33e 0x34008e4b 0x62cded79 0x5775e489 0x10ec14c6 0x9563333e 0x99073335 0x4a86add5 0x908a1442 0x557022bc 0x4f862511 0x44d7048d 0xa153b41d 0x9d150184 0xdfb0ceb1 0x8d104b75 0x9b3899cb 0x51febe6d 0x337fb8d0 0x7c1e2b04 0xfb8bc630 0x26b3f873 >;
			rsa,modulus = < 0xa0a7b27d 0xe8532b60 0x7bfb00bb 0xfceb03f4 0x763477e9 0xc3e584d8 0xb8cf3743 0xb7ba6869 0x7665b2fc 0x755c89d1 0xe5c2b044 0x80d30bfb 0x3a508377 0xe3ce4683 0xc450dd67 0x8fc42c72 0x8a7a72d0 0x88376b3 0xcb2b561f 0x2164a20f 0xe17aadbd 0x6bfa538a 0x54a92dc1 0x4f8f9407 0x290b57c6 0x11ad7450 0x15a180f2 0x9a8505fb 0xacd7f372 0x3e82970e 0xcb34c802 0xe24f121b 0x67a9ce0 0x5f235199 0x27adef84 0xeeb4e431 0x6098947d 0xfc909ef 0xc44324b3 0xb1bc24e9 0x48f41d81 0x1c2307aa 0xd78dce80 0x8cd772d4 0x43e013dd 0x3d3606a1 0x9103a7 0x6d94c861 0xfdc012c8 0xe104706a 0x4a8473e5 0xf24b8d73 0xe7f289a5 0xb02a64af 0xc6c4e652 0x8f88cbcc 0x5d279edd 0xedf5fa0b 0x9bbdd8c0 0x13852adc 0xaeb36ff6 0xa66b0fbc 0xacded62e 0x8f85eea7 0xf0b3a239 0xe6e4c7d6 0xe4a8356 0x394583f8 0xc98feb21 0xec80f9b2 0x7a9aba8f 0x17f0e45f 0xab885d51 0x1fa96332 0xd572742d 0xfa0a1ddd 0x9470c152 0xa5d6a814 0x7329d93c 0xccb825dd 0x712db79e 0x55e3725c 0x471fbb8b 0xa0524ea9 0x7c17ec80 0x745f9e25 0x8e054070 0x98c79776 0xb5fd8a4d 0xb07b24e3 0xc0f0fb56 0xf6c98ffa 0x9ef60d60 0x7a744a54 0x4898676c 0xdcf4225b 0x8551bf53 0xaeb73601 0x6eeec18e 0xdf28645 0x64242141 0xece00db7 0x66e0f6c5 0x3ab5c109 0xe6f2da56 0x90831a8a 0xe8653a46 0xac718040 0x328dbbdf 0x240e1b45 0x853a0a 0xeb618fee 0x6f39393d 0x7d2e87e7 0x2e7feeb0 0xf35ec62b 0xcc43a982 0x25fa68aa 0xf5bf5b51 0x81f241da 0x5620b31 0x7678c52f 0x75ea97e3 0xa0d7a016 0x4f58761a 0xa6fe250 0xc37ac7eb 0x7bccd275 >;
			rsa,exponent = < 0x00 0x10001 >;
			rsa,n0-inverse = < 0xdf071223 >;
			rsa,num-bits = < 0x1000 >;
			key-name-hint = "fit-mfg";
		};

		/* TODO: key-fit-qa */

		key-fit-prod {
			required = "prod:conf";
			algo = "sha256,rsa4096";
			rsa,r-squared = < 0x9d39b048 0x15658202 0x99542154 0x5f526e7f 0x95f9967d 0xb50fd19e 0x4617ab65 0xbb5e93ad 0x1e8b5b7c 0xd99892c1 0xe6d07a16 0xfb993c25 0x370144ac 0x5ffb7316 0xe7147586 0x2fb83d55 0x5b585673 0x5a79755 0xa02b335c 0x5c822ee7 0xd69155a6 0xaf109ba4 0xe087a2bf 0xd13583d4 0xd8c6ca48 0x64285e8c 0x1c1ed7cd 0x8ec738fe 0x6fb82ea0 0x27a7da83 0xe88140c1 0x6f9005b3 0x2dfad011 0x5e711781 0xd121fd42 0xc484c6dc 0x9b04a957 0x20d27566 0x42be45d5 0x9b78a1bb 0xc55314ee 0x55369b38 0x74e6fba7 0xf9403da2 0x973f689f 0x990f5535 0x89ecda2b 0xa144bb11 0x30dfec57 0x3a5ea952 0xd228196d 0x67a85b0b 0x16ae6a1e 0xa4f55140 0x8ba81d43 0xec824cc4 0x6a6acb85 0x7dd9b318 0x7accb666 0x6b5d3890 0xf113f19b 0x14706ee4 0xab9d9437 0x6a8cbc1a 0x55b86100 0x3f962c93 0x14672e91 0x9a688091 0xf1efaa89 0xc1b8ec0a 0x50dff18a 0x2555c98e 0x9aaaf5f 0xf9d7f832 0x2e010586 0xb1abc14d 0x21350ae3 0x8b2443d9 0x89bd85ab 0xd07dcf93 0xef417b38 0xda707b63 0x5971f6f4 0xb5721aa2 0xcd51a039 0xdc12228e 0x2c2c3f8a 0xb0a690b5 0x72906de5 0xd57576b1 0x5190d601 0xd7cce638 0x7dba54b7 0x9628e165 0x77a2f007 0x131b4bde 0xc0fa244f 0x9d00ca63 0x500dce6b 0xea233e14 0x888d3d4a 0xbd974fc3 0x33f9d304 0x49d5f6be 0x9384e74b 0x487aa9c3 0x4e80f498 0x1fc6d9cb 0x62a3a429 0xa3346154 0x3c679bef 0x4411fc35 0x648199bb 0xe89d0d12 0xc00ca206 0xc35af7f6 0xc1bbfce0 0x32217469 0x13e1026b 0x7ab5c86c 0x603840bc 0x83f75262 0x802e807b 0x82d1be9 0x831818c7 0x38d28713 0x147c4f4f 0xa66a7b44 >;
			rsa,modulus = < 0xbd57f4cf 0xe010230a 0x1ae6bbf4 0xcad961a 0xfed99918 0xbd515194 0x62087864 0xf5a6c3fa 0x4949c973 0xdb6dfa73 0xe7e12b1b 0xfba0e871 0x6bc7198b 0x525fa27c 0x52a5d051 0xc3148c8 0xe492a367 0x47bf84f5 0x5c49c6b 0xf0733cb6 0x5890ff48 0xed117a25 0xa5686d0 0x97f7ab61 0xdb069470 0x1e20d04b 0x50bf7832 0xd91e2a1b 0x1903a81 0xf10d569c 0x775d665b 0xda06c58a 0x8b49479c 0xd096f295 0x7997d1c9 0xaf9bb704 0xef93de5c 0x50277995 0x22b18844 0x2c509117 0x6c3eb642 0x6372eda 0x220a551a 0xf9c5dafa 0xaf949454 0x82c59319 0xdad44f5d 0x8821d3ad 0x7145c1e9 0x232fc888 0xacb2135d 0xaebbcdc4 0x1040d10d 0xf1ae59a0 0xc8d6d863 0x549019d8 0x94adf8a1 0xa97e1965 0x1c6881eb 0xd5bdc8d0 0x39f6e6b5 0xd888c67a 0xbb6df686 0x9217f247 0x436d0158 0xbac560e1 0x8617f2be 0x1047f819 0x32211f11 0x3302503 0x29bb754c 0x25726cf2 0x2cd7afc 0x5d7436d5 0x42d27294 0x95a5708a 0x15fb144b 0xca87d35 0x4c0074ef 0xbb4061a6 0x4619947b 0x430d6ce0 0x9072dba7 0xf0106cf3 0xcbcfa020 0x517ed350 0x41766f90 0x26a12caf 0x43520098 0xf78cfd0a 0x655d900c 0x3e091434 0x9182586c 0xc942a9dd 0x7193b721 0xf5eda4b2 0xb355de8f 0x672aea39 0x11249145 0xe6a8c659 0xda35a692 0x3afb4967 0xc5e364c4 0x5c199325 0xc10d83be 0x5893549c 0xc90284a3 0x7db29d11 0xbb9e1271 0x4af22538 0x28d2b21b 0x45891537 0x831939dc 0xd6e0fd96 0x905d5ab9 0x2a0d815f 0x7911ba83 0xe1bf1916 0x3b2e925e 0xdd5d6888 0x20d7df6 0x34cf1891 0x65b6809f 0xc63b206d 0xfbb0e4d5 0x2aa61751 0xe3056ae2 0xe59c71bf >;
			rsa,exponent = < 0x00 0x10001 >;
			rsa,n0-inverse = < 0xe58381c1 >;
			rsa,num-bits = < 0x1000 >;
			key-name-hint = "fit-prod";
		};
	};
};
