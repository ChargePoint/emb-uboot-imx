/*
 * This is a Device Tree representation of the public keys that will
 * be used for FIT image verification.
 *
 * The procedure to generate this file from production keys in AWS CloudHSM is
 * avaliable here:
 * https://github.com/ChargePoint/emb-platform/blob/master/os/buildroot/package/emb-sbsigner/README.md
 */

/ {

	signature {

		key-fit-prod {
			required = "prod:conf";
			algo = "sha256,rsa4096";
			rsa,r-squared = < 0x9d39b048 0x15658202 0x99542154 0x5f526e7f 0x95f9967d 0xb50fd19e 0x4617ab65 0xbb5e93ad 0x1e8b5b7c 0xd99892c1 0xe6d07a16 0xfb993c25 0x370144ac 0x5ffb7316 0xe7147586 0x2fb83d55 0x5b585673 0x5a79755 0xa02b335c 0x5c822ee7 0xd69155a6 0xaf109ba4 0xe087a2bf 0xd13583d4 0xd8c6ca48 0x64285e8c 0x1c1ed7cd 0x8ec738fe 0x6fb82ea0 0x27a7da83 0xe88140c1 0x6f9005b3 0x2dfad011 0x5e711781 0xd121fd42 0xc484c6dc 0x9b04a957 0x20d27566 0x42be45d5 0x9b78a1bb 0xc55314ee 0x55369b38 0x74e6fba7 0xf9403da2 0x973f689f 0x990f5535 0x89ecda2b 0xa144bb11 0x30dfec57 0x3a5ea952 0xd228196d 0x67a85b0b 0x16ae6a1e 0xa4f55140 0x8ba81d43 0xec824cc4 0x6a6acb85 0x7dd9b318 0x7accb666 0x6b5d3890 0xf113f19b 0x14706ee4 0xab9d9437 0x6a8cbc1a 0x55b86100 0x3f962c93 0x14672e91 0x9a688091 0xf1efaa89 0xc1b8ec0a 0x50dff18a 0x2555c98e 0x9aaaf5f 0xf9d7f832 0x2e010586 0xb1abc14d 0x21350ae3 0x8b2443d9 0x89bd85ab 0xd07dcf93 0xef417b38 0xda707b63 0x5971f6f4 0xb5721aa2 0xcd51a039 0xdc12228e 0x2c2c3f8a 0xb0a690b5 0x72906de5 0xd57576b1 0x5190d601 0xd7cce638 0x7dba54b7 0x9628e165 0x77a2f007 0x131b4bde 0xc0fa244f 0x9d00ca63 0x500dce6b 0xea233e14 0x888d3d4a 0xbd974fc3 0x33f9d304 0x49d5f6be 0x9384e74b 0x487aa9c3 0x4e80f498 0x1fc6d9cb 0x62a3a429 0xa3346154 0x3c679bef 0x4411fc35 0x648199bb 0xe89d0d12 0xc00ca206 0xc35af7f6 0xc1bbfce0 0x32217469 0x13e1026b 0x7ab5c86c 0x603840bc 0x83f75262 0x802e807b 0x82d1be9 0x831818c7 0x38d28713 0x147c4f4f 0xa66a7b44 >;
			rsa,modulus = < 0xbd57f4cf 0xe010230a 0x1ae6bbf4 0xcad961a 0xfed99918 0xbd515194 0x62087864 0xf5a6c3fa 0x4949c973 0xdb6dfa73 0xe7e12b1b 0xfba0e871 0x6bc7198b 0x525fa27c 0x52a5d051 0xc3148c8 0xe492a367 0x47bf84f5 0x5c49c6b 0xf0733cb6 0x5890ff48 0xed117a25 0xa5686d0 0x97f7ab61 0xdb069470 0x1e20d04b 0x50bf7832 0xd91e2a1b 0x1903a81 0xf10d569c 0x775d665b 0xda06c58a 0x8b49479c 0xd096f295 0x7997d1c9 0xaf9bb704 0xef93de5c 0x50277995 0x22b18844 0x2c509117 0x6c3eb642 0x6372eda 0x220a551a 0xf9c5dafa 0xaf949454 0x82c59319 0xdad44f5d 0x8821d3ad 0x7145c1e9 0x232fc888 0xacb2135d 0xaebbcdc4 0x1040d10d 0xf1ae59a0 0xc8d6d863 0x549019d8 0x94adf8a1 0xa97e1965 0x1c6881eb 0xd5bdc8d0 0x39f6e6b5 0xd888c67a 0xbb6df686 0x9217f247 0x436d0158 0xbac560e1 0x8617f2be 0x1047f819 0x32211f11 0x3302503 0x29bb754c 0x25726cf2 0x2cd7afc 0x5d7436d5 0x42d27294 0x95a5708a 0x15fb144b 0xca87d35 0x4c0074ef 0xbb4061a6 0x4619947b 0x430d6ce0 0x9072dba7 0xf0106cf3 0xcbcfa020 0x517ed350 0x41766f90 0x26a12caf 0x43520098 0xf78cfd0a 0x655d900c 0x3e091434 0x9182586c 0xc942a9dd 0x7193b721 0xf5eda4b2 0xb355de8f 0x672aea39 0x11249145 0xe6a8c659 0xda35a692 0x3afb4967 0xc5e364c4 0x5c199325 0xc10d83be 0x5893549c 0xc90284a3 0x7db29d11 0xbb9e1271 0x4af22538 0x28d2b21b 0x45891537 0x831939dc 0xd6e0fd96 0x905d5ab9 0x2a0d815f 0x7911ba83 0xe1bf1916 0x3b2e925e 0xdd5d6888 0x20d7df6 0x34cf1891 0x65b6809f 0xc63b206d 0xfbb0e4d5 0x2aa61751 0xe3056ae2 0xe59c71bf >;
			rsa,exponent = < 0x00 0x10001 >;
			rsa,n0-inverse = < 0xe58381c1 >;
			rsa,num-bits = < 0x1000 >;
			key-name-hint = "fit-prod";
		};
	};
};
