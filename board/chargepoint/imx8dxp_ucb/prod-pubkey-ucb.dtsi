/*
 * This is a Device Tree representation of the public keys that will
 * be used for FIT image verification.
 *
 * The procedure to generate this file from production keys in AWS CloudHSM is
 * avaliable here:
 * https://github.com/ChargePoint/emb-platform/blob/master/os/buildroot/package/emb-sbsigner/README.md
 */

/ {

	signature {

		key-fit-prod {
			required = "prod:conf";
			algo = "sha256,rsa4096";
			rsa,r-squared = < 0x424797e2 0xacab07c3 0x666816b8 0xf5cb05e8 0x8bb0009e 0x5e9ffb89 0xe41772b2 0x8019061b 0xe301e3f0 0xf9d37d7 0xe5e8fe30 0x4a8717f8 0xc91a63da 0xdfa1f102 0x37469e72 0x2a701d4f 0xe9fb842c 0x65135bc0 0xa6644159 0xa62f0138 0x59d77267 0x927c78ea 0x23f096a2 0x40988a6c 0xb34808fe 0x6a639105 0x86211119 0xf3d19fc1 0x700c0f8b 0x4d73bbb9 0x6b9b2966 0xb4a9ca0d 0xbff703da 0xcde29e3a 0x5319961b 0xc3722152 0x65c7d25e 0x4f9587f3 0x842ee827 0x217a9d34 0xfed89af2 0x26b4056b 0x8d2811ff 0x1a13a46e 0xca1f3d9b 0xd781a633 0x122ca609 0x53805f99 0xbae070b8 0x3e7ffb2 0x22b1122a 0x5cc133b7 0xdd49f320 0x82f72dd3 0xb21634e7 0x693fbec0 0x503cb6ca 0x550e8bfc 0x7376bc00 0xd8a015e4 0xa2f91d68 0x47727f9f 0xb300ccd4 0x925fe628 0xae1664fd 0x65615600 0xb79fa50a 0x4e388dd2 0x368e52de 0x38a23119 0x8434c67f 0x2de747c6 0x7dff919 0xf22e0e55 0xa094d6e3 0xddd4d4ba 0xa32097dc 0x7622c006 0x50601b20 0x847d2967 0x9d1245e6 0x9d8abf42 0xbf535315 0xa549fabf 0xc5f2de9b 0xe8c49643 0x7a914dde 0xd235d1ea 0x9e9d5dd6 0xfc470d2d 0xb9821e12 0x7009f134 0xacd98c75 0x30ae12d3 0xcd739e53 0x2ac9dff2 0x15fcfb2e 0x3052b534 0xa917ed57 0x2c7c3f6b 0x1f0386f1 0xbfc58811 0x68bf8832 0xe30c11b0 0x56a96a8f 0xff22209d 0x28ebd0f6 0xafa2a69d 0xb8d606cf 0x26067912 0x8b60ad9e 0x64d8fada 0x7875c644 0xa6ce01f0 0x92b36719 0x35b77e98 0xadeeb720 0x90fff35b 0xc7a6a744 0xba193f60 0xdce91a0a 0xe847dcf5 0x3fbff0dd 0xa39cf4a9 0xe131da3c 0x9d62825d 0x9126e554 0x65009c4a >;
			rsa,modulus = < 0xbe8720bc 0xd9330c4d 0xa5cec8f1 0x3b6974be 0x8aea3c94 0x8acbacd0 0x7218da0a 0xe62bdaf0 0xa36d76b7 0x90668ea 0xc17a094f 0xc2f97142 0x5a928987 0x6878a9d5 0x2135bef1 0x11e43a54 0xe3b648cc 0xf48fc959 0xb60243db 0x79829a1e 0xa177b15b 0x993b71f9 0x9d908b46 0x86e4fa9b 0xf58797ab 0x47ea8996 0x8b6e49f3 0x6df48208 0xeb10c907 0x690290f1 0xccacc9cd 0x6fc8f150 0xe834a509 0x3e1175dd 0xef3603f6 0x3ded2aa 0x41366f84 0x4bbd1290 0xa34fb06e 0x31d4bdcf 0x4e2a70e4 0x92a16dbf 0x7dc3ccf0 0xc79a52a3 0xaa9978b7 0x67e045cd 0x5f1df0d8 0x88743746 0x34dd619c 0x9e8b108f 0xf4651d76 0x1ca2857 0x1abc20d7 0x7da63ab8 0xe2057bc3 0x151ee5ab 0xab3dfafa 0x8116606c 0xe8391f7d 0xb141681e 0x1c4a65b7 0x15b5a64d 0x2ce1d35e 0xde42d176 0x8e1bfb0d 0x3b1f0f6f 0xf611e6be 0x218e6431 0xe2711710 0x9ce0e015 0x482c6258 0xa34f00ad 0x90859f5a 0xb7bbc25f 0xfd8cc1ef 0x4b0c05ab 0xbc6d60bf 0x907d2d80 0xa9736c1d 0x6be387dc 0xc09806b8 0xc6b31a90 0x2536ee79 0x5bd6dec9 0x8cfc271e 0x44ca0b3d 0x5bc9893d 0xf68606fe 0x90623a94 0x3b32d66 0x32726998 0x36a50efb 0xb12c0a8d 0x4f7cec81 0xbf492fcc 0x18347b24 0x7ddeabc3 0x424884d7 0xb7c92b72 0x52d5f14f 0x4cfb8ed3 0xfe8358f2 0xece6b577 0x5e04b7eb 0x5ea6cc78 0x9c29acf1 0xaf47f27d 0xbb053a24 0xfd369904 0x78ab8e74 0x49ee205e 0x45bc6722 0x1d9a1391 0x7403bc7e 0x373f31ba 0x19377d3e 0xe2cbc7b2 0x7a088ea1 0x75fb97e8 0xcbc118aa 0x70b28a43 0xd0886a54 0x7056b876 0xdd81f2a3 0x90da58d1 0x8d9a65f0 0x9c8309c0 0x8d0805bd >;
			rsa,exponent = < 0x00 0x10001 >;
			rsa,n0-inverse = < 0xf854a26b >;
			rsa,num-bits = < 0x1000 >;
			key-name-hint = "fit-prod";
		};
	};
};
