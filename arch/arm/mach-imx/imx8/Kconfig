## arch/arm/mach-imx/imx8/Kconfig
```kconfig
if ARCH_IMX8

config AHAB_BOOT
	bool "Support i.MX8 AHAB features"
	imply CMD_DEKBLOB
	help
	  This option enables the support for AHAB secure boot.

config IMX_LOAD_HDMI_FIMRWARE_RX
	bool "Enable HDMI rx firmware loading"
	depends on ARCH_IMX8 || VIDEO_IMX_HDP_LOAD
	help
	  This enable the hdmi rx firmware loading. It depends on the "hdprx" command.

config IMX_LOAD_HDMI_FIMRWARE_TX
	bool "Enable HDMI tx firmware loading"
	depends on ARCH_IMX8 || VIDEO_IMX_HDP_LOAD
	help
	  This enable the hdmi tx firmware loading. It depends on the "hdp" command.

config IMX8
	bool
	select HAS_CAAM

config MU_BASE_SPL
	hex "MU base address used in SPL"
	default 0x5d1b0000
	help
	  SPL runs in EL3 mode, it use MU0_A to communicate with SCU.
	  So we could not reuse the one in dts which is for normal U-Boot.

config IMX8QM
	select IMX8
	select SUPPORT_SPL
	select SPL_RECOVER_DATA_SECTION if SPL
	bool

config IMX8QXP
	select IMX8
	select SUPPORT_SPL
	select SPL_RECOVER_DATA_SECTION if SPL
	bool

config IMX8DXL
	select IMX8
	select SUPPORT_SPL
	select SPL_RECOVER_DATA_SECTION if SPL
	bool

config SYS_SOC
	default "imx8"

config BOOTAUX_RESERVED_MEM_BASE
	hex "i.MX auxiliary core dram memory base"
	default 0

config BOOTAUX_RESERVED_MEM_SIZE
	hex "i.MX auxiliary core dram memory size"
	default 0

config PSCI_BOARD_REBOOT
	bool "Enable psci board reboot command"
	depends on ARM_PSCI_FW
	help
	  This is a optional command used to trigger system board reboot on imx8.

choice
	prompt "i.MX8 board select"
	optional

config TARGET_APALIS_IMX8
	bool "Support Apalis iMX8 module"
	select BOARD_LATE_INIT
	select IMX8QM

config TARGET_COLIBRI_IMX8X
	bool "Support Colibri iMX8X module"
	select BINMAN
	select BOARD_LATE_INIT
	select IMX8QXP

config TARGET_DENEB
	bool "Support i.MX8QXP Capricorn Deneb board"
	select BINMAN
	select BOARD_LATE_INIT
	select FACTORYSET
	select IMX8QXP

config TARGET_GIEDI
	bool "Support i.MX8QXP Capricorn Giedi board"
	select BINMAN
	select BOARD_LATE_INIT
	select FACTORYSET
	select IMX8QXP

config TARGET_IMX8QM_MEK
	bool "Support i.MX8QM MEK board"
	select BOARD_LATE_INIT
	select IMX8QM
	select FSL_CAAM
	select FSL_BLOB
	select ARCH_MISC_INIT
	select SPL_CRYPTO if SPL

config TARGET_IMX8QM_LPDDR4_VAL
	bool "Support i.MX8QM lpddr4 validation board"
	select BOARD_LATE_INIT
	select IMX8QM

config TARGET_IMX8QM_DDR4_VAL
	bool "Support i.MX8QM ddr4 validation board"
	select BOARD_LATE_INIT
	select IMX8QM

config TARGET_CONGA_QMX8
	bool "Support congatec conga-QMX8 board"
	select BINMAN
	select BOARD_LATE_INIT
	select SUPPORT_SPL
	select IMX8QM

# NOTE: select correct SoC variant when DXP is supported
config TARGET_IMX8DXP_UCB
	bool "Support i.MX8DXP UCB board"
	select BOARD_LATE_INIT
	select SUPPORT_SPL
	select IMX8QXP

config TARGET_IMX8QXP_LPDDR4_ARM2
	bool "Support i.MX8QXP lpddr4 validation board"
	select BOARD_LATE_INIT
	select IMX8QXP

config TARGET_IMX8QXP_DDR3_VAL
	bool "Support i.MX8QXP ddr3 validation board"
	select BOARD_LATE_INIT
	select IMX8QXP

config TARGET_IMX8X_17X17_VAL
	bool "Support i.MX8QXP/DX 17x17 validation board"
	select BOARD_LATE_INIT
	select IMX8QXP

config TARGET_CHARGEPOINT_IMX8DXL_KCB
	bool "Support i.MX8DXL board(evk)"
	select BOARD_LATE_INIT
	select IMX8DXL

config TARGET_IMX8DXL_PHANTOM_MEK
	bool "Support i.MX8DXL PHANTOM MEK board"
	select BOARD_LATE_INIT
	select IMX8QXP
	select FSL_CAAM
	select FSL_BLOB
	select ARCH_MISC_INIT
	select SPL_CRYPTO if SPL

config TARGET_CHARGEPOINT_IMX8DXL_KCB
	bool "Support i.MX8DXL chargepoint kcb"
	select BOARD_LATE_INIT
	select IMX8DXL

# NOTE: select correct SoC variant when DXP is supported
config TARGET_CHARGEPOINT_IMX8DXP_UCB
	bool "Support i.MX8DXP chargepoint ucb"
	select BOARD_LATE_INIT
# Causes failures in imx_bootaux.c	select IMX8DXP
	select IMX8QXP

config TARGET_IMX8DX_MEK
	bool "Support i.MX8DX MEK board"
	select BOARD_LATE_INIT
	select SUPPORT_SPL
	select IMX8QXP
	select FSL_CAAM
	select FSL_BLOB
	select ARCH_MISC_INIT
	select SPL_CRYPTO if SPL

config TARGET_IMX8DXL_EVK
	bool "Support i.MX8DXL EVK board"
	select BOARD_LATE_INIT
	select IMX8DXL
	select FSL_CAAM
	select FSL_BLOB
	select ARCH_MISC_INIT
	select SPL_CRYPTO if SPL

config TARGET_IMX8DXL_DDR3_EVK
	bool "Support i.MX8DXL EVK board"
	select BOARD_LATE_INIT
	select IMX8DXL
	select FSL_CAAM
	select FSL_BLOB
	select ARCH_MISC_INIT
	select SPL_CRYPTO if SPL

config TARGET_IMX8DXL_ORANGEBOX
	bool "Support i.MX8DXL OrangeBox board"
	select BOARD_LATE_INIT
	select IMX8DXL
	select FSL_CAAM
	select FSL_BLOB
	select ARCH_MISC_INIT
	select SPL_CRYPTO if SPL

endchoice

source "board/chargepoint/imx8dxl_kcb/Kconfig"
source "board/freescale/imx8qm_mek/Kconfig"
source "board/freescale/imx8qxp_mek/Kconfig"
source "board/congatec/cgtqmx8/Kconfig"
source "board/freescale/imx8qm_val/Kconfig"
source "board/freescale/imx8qxp_val/Kconfig"
source "board/freescale/imx8dxl_phantom_mek/Kconfig"
source "board/freescale/imx8dxl_evk/Kconfig"
source "board/freescale/imx8dxl_orangebox/Kconfig"
source "board/advantech/imx8qm_rom7720_a1/Kconfig"
source "board/toradex/apalis-imx8/Kconfig"
source "board/toradex/colibri-imx8x/Kconfig"
source "board/siemens/capricorn/Kconfig"

#source "board/chargepoint/imx8dxl_kcb/Kconfig"
source "board/chargepoint/imx8dxp_ucb/Kconfig"

config SKIP_RESOURCE_CHECKING
	bool "Skip resource owner checking to kernel FDT nodes"
	help
	  By default the kernel FDT nodes are checked if belong to current partition.
	  Set the config to skip this checking.

config SNVS_SEC_SC
	bool "Support SNVS configuration"
	help
	  Allow to configure the SNVS via SCU API to configure tampers and secure
	  violation.

config IMX_SNVS_SEC_SC_AUTO
	bool "Support SNVS configuration command"
	depends on IMX_SNVS_SEC_SC
	help
	  This configuration will apply the selected configurations automatically
	  at boot.

endif
```

## board/chargepoint/common/Kconfig
```kconfig
config CHARGEPOINT_MFG
	bool "chargepoint-mfg"
	default n
	help
	  If set, builds the image to look for mfg keys rather than the
	  default fit keys. This changes the verification for the images
	  so that only mfg images should be boot with this configuration.
```

## board/chargepoint/imx6cpnk/Kconfig
```kconfig
if TARGET_IMX6CPNK

config SYS_BOARD
	default "imx6cpnk"

config SYS_VENDOR
	default "chargepoint"

config SYS_SOC
	default "mx6"

config SYS_CONFIG_NAME
	default "imx6cpnk"

config SYS_TEXT_BASE
	default 0x17800000

source "board/freescale/common/Kconfig"

endif
```

## board/chargepoint/imx8dxl_kcb/Kconfig
```kconfig
if  TARGET_CHARGEPOINT_IMX8DXL_KCB

config SYS_BOARD
	default "imx8dxl_kcb"

config SYS_VENDOR
	default "chargepoint"

config SYS_CONFIG_NAME
	default "chargepoint_imx8dxl_kcb"

source "board/freescale/common/Kconfig"

endif
```

## board/chargepoint/imx8dxl_pmc/Kconfig
```kconfig
if  TARGET_CHARGEPOINT_IMX8DXL_PMC

config SYS_BOARD
	default "imx8dxl_pmc"

config SYS_VENDOR
	default "chargepoint"

config SYS_CONFIG_NAME
	default "chargepoint_imx8dxl_pmc"

endif
```

## board/chargepoint/imx8dxp_ucb/Kconfig
```kconfig
if TARGET_CHARGEPOINT_IMX8DXP_UCB

config SYS_BOARD
	default "imx8dxp_ucb"

config SYS_VENDOR
	default "chargepoint"

config SYS_CONFIG_NAME
	default "chargepoint_imx8qxp_mek"

# RMW Note PLAT-5675 didn't have this board/chargepoint/common/Kconfig
source "board/chargepoint/common/Kconfig"
# RMW no longer available - source "board/freescale/common/Kconfig"

endif
```

## board/chargepoint/imx8mm_mcb/Kconfig
```kconfig
if TARGET_CHARGEPOINT_IMX8MM_MCB

config SYS_BOARD
	default "imx8mm_mcb"

config SYS_VENDOR
	default "chargepoint"

config SYS_CONFIG_NAME
	default "chargepoint_imx8mm_mcb"

config IMX_CONFIG
	default "board/chargepoint/imx8mm_mcb/imximage-8mm.cfg"

config IMX8M_1G_MEMORY
	bool "imx8m 1GB memory size"

endif
```

## board/chargepoint/imx8mm_sbc/Kconfig
```kconfig
if TARGET_CHARGEPOINT_IMX8MM_SBC

config SYS_BOARD
	default "imx8mm_sbc"

config SYS_VENDOR
	default "chargepoint"

config SYS_CONFIG_NAME
	default "chargepoint_imx8mm_sbc"

source "board/freescale/common/Kconfig"

endif
```

## board/chargepoint/imx93_cpcm/Kconfig
```kconfig
if  TARGET_CHARGEPOINT_IMX93_CPCM

config SYS_BOARD
	default "imx93_cpcm"

config SYS_VENDOR
	default "chargepoint"

config SYS_CONFIG_NAME
	default "chargepoint_imx93_cpcm"

config IMX93_CPCM_LPDDR4X
	bool "Using LPDDR4X Timing and PMIC voltage"
	default y
	select IMX9_LPDDR4X
	help
	  Select the LPDDR4X timing and 0.6V VDDQ

endif
```

## board/freescale/imx8dxp_ucb/Kconfig
```kconfig
if TARGET_IMX8DXP_UCB

config SYS_BOARD
	default "imx8dxp_ucb"

config SYS_VENDOR
	default "freescale"

config SYS_CONFIG_NAME
	default "imx8dxp_ucb"

source "board/freescale/common/Kconfig"

endif
```

## board/freescale/imx8qxp_ucb/Kconfig
```kconfig
if TARGET_IMX8QXP_UCB

config SYS_BOARD
	default "imx8qxp_ucb"

config SYS_VENDOR
	default "freescale"

config SYS_CONFIG_NAME
	default "imx8qxp_ucb"

source "board/freescale/common/Kconfig"

endif
```

## board/freescale/mx6sabresd_cpnk/Kconfig
```kconfig
if TARGET_MX6QPSABRESD_CPNK

config SYS_BOARD
	default "mx6sabresd_cpnk"

config SYS_VENDOR
	default "freescale"

config SYS_SOC
	default "mx6"

config SYS_CONFIG_NAME
	default "mx6sabresd_cpnk"

config SYS_TEXT_BASE
    default 0x17800000

endif
```

## board/freescale/mx6sabresd_pbc/Kconfig
```kconfig
if TARGET_MX6DLSABRESD_PBC

config SYS_BOARD
	default "mx6sabresd_pbc"

config SYS_VENDOR
	default "freescale"

config SYS_SOC
	default "mx6"

config SYS_CONFIG_NAME
	default "mx6sabresd_pbc"

config SYS_TEXT_BASE
    default 0x17800000

config CONSOLE_DEV
    default "ttymxc0"

config OTA_ENV_SETTINGS
    default ""

config SYS_HUSH_PARSER
    bool y

config SYS_NOSMP
    bool y

endif
```

## configs/chargepoint_imx6cpnk_ddrv2_SECURE_BOOT_defconfig
```kconfig
CONFIG_ARM=y
CONFIG_ARCH_MX6=y
CONFIG_SECURE_BOOT=y
CONFIG_TARGET_IMX6CPNK=y
# CONFIG_CMD_BMODE is not set
# CONFIG_CMD_DEKBLOB is not set
CONFIG_DEFAULT_DEVICE_TREE="imx6qp-chargepoint-cpnk"
CONFIG_FIT=y
CONFIG_FIT_SIGNATURE=y
CONFIG_FIT_VERBOSE=y
CONFIG_FIT_BEST_MATCH=y
CONFIG_SYS_EXTRA_OPTIONS="IMX_CONFIG=board/chargepoint/imx6cpnk/mx6qp_cpnk_ddrv2.cfg,MX6QP"
CONFIG_SD_BOOT=y
CONFIG_BOOTDELAY=0
CONFIG_SYS_CONSOLE_OVERWRITE_ROUTINE=y
CONFIG_DEFAULT_FDT_FILE="imx6qp-chargepoint-cpnk.dtb"
CONFIG_HUSH_PARSER=y
CONFIG_NOT_UUU_BUILD=y
CONFIG_CMD_BOOTZ=y
# CONFIG_CMD_BOOTEFI_HELLO_COMPILE is not set
# CONFIG_CMD_ELF is not set
# CONFIG_CMD_SAVEENV is not set
# CONFIG_CMD_FLASH is not set
CONFIG_CMD_GPIO=y
CONFIG_CMD_GPT=y
# CONFIG_RANDOM_UUID is not set
CONFIG_CMD_I2C=y
CONFIG_CMD_MMC=y
CONFIG_CMD_PART=y
CONFIG_CMD_SF=y
CONFIG_CMD_USB=y
CONFIG_CMD_FUSE=y
# CONFIG_CMD_NET is not set
# CONFIG_CMD_NFS is not set
CONFIG_CMD_CACHE=y
# CONFIG_CMD_HASH is not set
CONFIG_CMD_EXT2=y
CONFIG_CMD_EXT4=y
CONFIG_CMD_EXT4_WRITE=y
CONFIG_CMD_FAT=y
CONFIG_CMD_FS_GENERIC=y
CONFIG_PARTITION_TYPE_GUID=y
CONFIG_OF_CONTROL=y
CONFIG_OF_BOARD_SETUP=y
CONFIG_ENV_IS_NOWHERE=y
# CONFIG_NET is not set
CONFIG_DM_GPIO=y
CONFIG_DM_ETH=y
CONFIG_PINCTRL=y
CONFIG_PINCTRL_IMX6=y
CONFIG_DM_REGULATOR=y
CONFIG_DM_REGULATOR_PFUZE100=y
CONFIG_DM_REGULATOR_FIXED=y
CONFIG_DM_REGULATOR_GPIO=y
CONFIG_USB=y
CONFIG_DM_USB=y
CONFIG_VIDEO=y
CONFIG_REGEX=y
CONFIG_LZO=y
```

## configs/chargepoint_imx6cpnk_ddrv2_defconfig
```kconfig
CONFIG_ARM=y
CONFIG_ARCH_MX6=y
CONFIG_TARGET_IMX6CPNK=y
CONFIG_DEFAULT_DEVICE_TREE="imx6qp-chargepoint-cpnk"
CONFIG_FIT=y
CONFIG_FIT_VERBOSE=y
CONFIG_FIT_BEST_MATCH=y
CONFIG_SYS_EXTRA_OPTIONS="IMX_CONFIG=board/chargepoint/imx6cpnk/mx6qp_cpnk_ddrv2.cfg,MX6QP"
CONFIG_SD_BOOT=y
CONFIG_BOOTDELAY=6
CONFIG_SYS_CONSOLE_OVERWRITE_ROUTINE=y
CONFIG_DEFAULT_FDT_FILE="imx6qp-chargepoint-cpnk.dtb"
CONFIG_HUSH_PARSER=y
CONFIG_FASTBOOT=y
CONFIG_FSL_FASTBOOT=y
CONFIG_FASTBOOT_BUF_ADDR=0x12C00000
CONFIG_FASTBOOT_BUF_SIZE=0x40000000
CONFIG_CMD_BOOTZ=y
CONFIG_CMD_MEMTEST=y
CONFIG_CMD_DFU=y
# CONFIG_CMD_FLASH is not set
CONFIG_CMD_GPIO=y
CONFIG_CMD_GPT=y
# CONFIG_RANDOM_UUID is not set
CONFIG_CMD_I2C=y
CONFIG_CMD_MMC=y
CONFIG_CMD_PART=y
CONFIG_CMD_SF=y
CONFIG_CMD_USB=y
CONFIG_CMD_USB_MASS_STORAGE=y
CONFIG_CMD_DHCP=y
CONFIG_CMD_MII=y
CONFIG_CMD_PING=y
CONFIG_CMD_CACHE=y
CONFIG_CMD_FUSE=y
CONFIG_CMD_PMIC=y
CONFIG_CMD_REGULATOR=y
CONFIG_CMD_EXT2=y
CONFIG_CMD_EXT4=y
CONFIG_CMD_EXT4_WRITE=y
CONFIG_CMD_FAT=y
CONFIG_CMD_FS_GENERIC=y
CONFIG_PARTITION_TYPE_GUID=y
CONFIG_OF_CONTROL=y
CONFIG_OF_BOARD_SETUP=y
CONFIG_ENV_IS_NOWHERE=y
CONFIG_DFU_SF=y
CONFIG_DM_GPIO=y
CONFIG_DM_I2C=y
CONFIG_DM_I2C_COMPAT=y
CONFIG_SYS_I2C_MXC=y
CONFIG_DM_ETH=y
CONFIG_PINCTRL=y
CONFIG_PINCTRL_IMX6=y
CONFIG_DM_PMIC=y
CONFIG_DM_PMIC_PFUZE100=y
CONFIG_DM_REGULATOR=y
CONFIG_DM_REGULATOR_PFUZE100=y
CONFIG_DM_REGULATOR_FIXED=y
CONFIG_DM_REGULATOR_GPIO=y
CONFIG_USB=y
CONFIG_DM_USB=y
CONFIG_USB_STORAGE=y
CONFIG_USB_GADGET=y
CONFIG_USB_GADGET_MANUFACTURER="FSL"
CONFIG_USB_GADGET_VENDOR_NUM=0x0525
CONFIG_USB_GADGET_PRODUCT_NUM=0xa4a5
CONFIG_CI_UDC=y
CONFIG_VIDEO=y
CONFIG_LZO=y
```
